/*
* Copyright (C) 2016, Daniel Herczeg
*
* Device-Tree overlay fuer den Macintosh Classic CRT-Monitor
*
* Compile with: dtc -I dts -O dtb -o BB-BONE-PRU-00A0.dtbo -@ BB-BONE-PRU-01-00A0.dts
* Load with: echo BB-BONE-PRU:00A0 > $SLOTS
*
* This program is free software; you can redistribute it and/or modify
* it under the terms of the GNU General Public License version 3 as
* published by the Free Software Foundation.
*
* It can be viewed here: http://www.gnu.org/licenses/gpl-3.0.de.html
*/
/dts-v1/;
/plugin/;

/ {
	/* kompatible geraete angeben */
	compatible = "ti,beaglebone-black";

	/* identifikation */
	part-number = "BB-BONE-PRU-01";
	version = "00A0";

	/* Dieses cape verwendet die folgenden Ressourcen */
	exclusive-use = "P9.27", "P9.28", "P9.25", "pru0";

	fragment@0{
		/* target im device tree */
		target = <&am33xx_pinmux>;
		
		/* das folgende overlay wird fuer das angegebene target definiert */
		__overlay__{
			/* Die PRU pins mithilfe des pin-multiplexing (pinmux) */
			/* in den richtigen Modus schalten (Siehe Tabelle aus dem Buch) */
			pru_pru_pins: pinmux_pru_pru_pins{
				/* pr1_pru0_pru_r30_5, mode5, out */
				/* pr1_pru0_pru_r30_3, mode5, out */
				/* pr1_pru1_pru_r30_1, mode5, out*/
				/* 0x25 = b'100101 */
				pinctrl-single,pins = < 0x1a4 0x25
										0x19c 0x25
										0x1ac 0x25 >;
			};
		};
	};

	fragment@2{
		target = <&pruss>;
		__overlay__{
			status = "okay";

			pinctrl-names = "default";
			pinctrl-0 = <&pru_pru_pins>;
			/* pinctrl-1 = <&pru_pru_pins>;  not sure, remove this if pru_write_data stops working */
		};
	};
};
